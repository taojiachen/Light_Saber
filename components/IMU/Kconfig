## components/IMU/Kconfig
```kconfig
# components/imu_solver/Kconfig
menu "IMU Solver Configuration"

choice
    prompt "Select IMU Driver"
    default IMU_MPU6050
    help
        Choose the target IMU hardware.

    config IMU_MPU6050
        bool "MPU6050 (6-axis)"
    # 未来可在此添加其他型号，如 config IMU_ICM20948
endchoice

# ---------- I2C 配置（仅当使用 I2C 传感器时） ----------
# config IMU_I2C_PORT
#     int "I2C peripheral index (e.g., 0 for I2C0)"
#     default 0
#     depends on IMU_MPU6050   # 或其他 I2C 传感器

# config IMU_I2C_SDA_PIN
#     int "I2C SDA pin number"
#     default 21
#     depends on IMU_MPU6050

# config IMU_I2C_SCL_PIN
#     int "I2C SCL pin number"
#     default 22
#     depends on IMU_MPU6050

# config IMU_I2C_CLK_SPEED
#     int "I2C clock speed (Hz)"
#     default 400000
#     range 100000 1000000
#     depends on IMU_MPU6050

# 各传感器地址
if IMU_MPU6050
config MPU6050_I2C_ADDRESS
    hex "MPU6050 I2C address"
    default 0x68
    help
        I2C address of MPU6050, usually 0x68 or 0x69 when AD0 is high.
endif

endmenu
```
